/dts-v1/;
/include/ "samd21.dtsi"

/ {
    model = "Seeed XIAO SAMD21";
    compatible = "seeed,xiao-samd21";

    chosen {
        zephyr,console = &sercom0;   /* 任意：シリアル等を使う場合 */
    };
};

/* PORTA/PORTB は samd21.dtsi 内で atmel,sam0-gpio として定義済み */
&porta { status = "okay"; };
&portb { status = "okay"; };
